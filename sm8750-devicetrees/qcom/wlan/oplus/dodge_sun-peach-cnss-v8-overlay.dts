/dts-v1/;
/plugin/;

#include <dt-bindings/oplus/hw-id.h>
#include "dodge_sun-peach-cnss-v8-overlay.dtsi"

/ {
	model = "Qualcomm Technologies, Inc. Sun SoCs, dodge";

	oplus,project-id = <23821 23893 23894 23895>;
};
